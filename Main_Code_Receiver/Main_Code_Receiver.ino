/*NOTES SO FAR
Components used 
-HC-12 Radio Module
-Tmp112 module
-GPS Neo-6M module
-ESP32 as microcontroller
-OLED display
*/

#include <Wire.h>
#include <Adafruit_SSD1306.h>
#include <TinyGPSPlus.h>
#include <ESP32Servo.h> 
Servo myservo;
#define SERVO_PIN 13      // Change if needed
#define LED_PIN 2
#define SERVO_CHANNEL 0
#define SERVO_FREQ 50      // 50 Hz for servo
#define SERVO_RES 16       // 16-bit resolution

#define SERVO_MIN_US 500   // 0°
#define SERVO_MAX_US 2400  // 180°

#define STATE_MAIN_MENU     0
#define STATE_CONFIG_MENU   1
#define STATE_CONFIG_SERVO  2
#define STATE_CONFIG_THROTTLE 3
#define STATE_CONFIG_LIVEVIEW 4
#define STATE_BL_LINK       5
#define STATE_LIVE_VIEW 6

#define SCREEN_WIDTH 128
#define SCREEN_HEIGHT 64
#define OLED_RESET -1
#define SCREEN_ADDRESS 0x3C
#define TMP102_ADDRESS 0x49
#define RXD2 16
#define TXD2 17
HardwareSerial neogps(1);
TinyGPSPlus gps;

Adafruit_SSD1306 display(SCREEN_WIDTH, SCREEN_HEIGHT, &Wire, OLED_RESET);

boolean newData = false;
int buttonPinSelect = 15;        // Example GPIO for button
int buttonPinPush= 14;
int buttonPinBack =12;
int selectedItem = 0;      // Tracks which menu item is selected 
int inmenu = 1;
int configItem = 0; // tracks the menu for the config settings
int configMenuState = 0;
const int menuItemsCount = 3;
const int configItemsCount = 3;
int value5 = 0;
unsigned long lastPacketTime = 0;   // Track last HC-12 packet time
const unsigned long timeout = 1000; // 1 second timeout for connection

String menuItems[menuItemsCount] = {"LIVE VIEW", "CONFIG", "BT LINK"};
String configItems[configItemsCount] = {"SET SERVO","SET THROTTLE","LIVEVIEW CONFIG"};

unsigned long lastDebounceTime = 0;
unsigned long debounceDelay = 200; // debounce in ms

// Variables for loading animation
unsigned long lastDotUpdate = 0;
int dotCount = 0;
int count = 0;

// ------------------ STARTUP PHASE ------------------

const unsigned char car_bitmap[] = {
  0x00, 0x00, 0x00, 0x00, 0x00, 0x00, 0x00, 0x00, 0x00, 0x00, 0x00, 0x00, 0x00, 0x00, 0x00, 0x00, 0x00, 0x00, 0x00, 0x00, 0x00, 0x00, 0x00, 0x00, 
  0x00, 0x00, 0x00, 0x00, 0x00, 0x00, 0x00, 0x00, 0x00, 0x00, 0x00, 0x00, 0x00, 0x00, 0x00, 0x00, 0x00, 0x00, 0x00, 0x00, 0x00, 0x00, 0x00, 0x00, 
  0x00, 0x00, 0x00, 0x00, 0x00, 0x00, 0x00, 0x00, 0x00, 0x00, 0x00, 0x00, 0x00, 0x00, 0x00, 0x00, 0x00, 0x00, 0x00, 0x01, 0x80, 0x19, 0x8C, 0x00, 
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  0x00, 0x00, 0x00, 0x00, 0x00, 0x00, 0x00, 0x00, 0x00, 0x00, 0x00, 0x00, 0x00, 0x00, 0x00, 0x00
};

float getTemperature()
{ 
 Wire.requestFrom(TMP102_ADDRESS,2); 
 byte MSB = Wire.read();
 byte LSB = Wire.read();
 //it's a 12bit int, using two's compliment for negative
 int TemperatureSum = (MSB << 4) + (LSB >> 4); // ((MSB << 8)| LSB) >> 4)
 float celsius;
 if(TemperatureSum & 0b100000000000)
 { 
 TemperatureSum = ~ TemperatureSum; 
 TemperatureSum += 1;
 TemperatureSum = TemperatureSum & 0b111111111111;
 celsius = TemperatureSum * -0.0625;
 } 
 else
 celsius = TemperatureSum*0.0625;
 return celsius; 
} 

void display_welcome() {
  display.clearDisplay();
  display.setTextSize(2);
  display.setTextColor(WHITE);

  display.drawBitmap(0, 0, car_bitmap, 128, 64, WHITE);

  display.display();
}

void display_live_view(){
  display.clearDisplay();
  display.setTextSize(1);
  display.setTextColor(WHITE);

  display.setCursor(40, 5);
  display.print("LIVEVIEW");

  display.setCursor(5, 18);
    display.print("Speed:");
    if(newData == true)
    {
      display.print(gps.speed.kmph());
      display.print(" Kph");
      display.setCursor(95, 5);
      display.print("S:");
      display.setCursor(110, 5);
      display.print(gps.satellites.value());
    }
    else display.print("NO GPS");
    display.setCursor(5, 33);
    display.print("Temp:");
    display.print(getTemperature(),2);
    display.print(" C");

    display.setCursor(5, 48);
    display.print("Current:0.00");
    display.print(" A");

  display.display();
 
}

void display_config(){
  display.clearDisplay();
  display.setTextSize(1);
  display.setTextColor(WHITE);

  display.setCursor(45, 5);
  display.print("CONFIG");

  display.setCursor(5, 18);
    display.print("SET SERVO");
    display.setCursor(5, 33);
    display.print("SET THROTTLE");
    display.setCursor(5, 48);
    display.print("LIVEVIEW OPTIONS");

  display.display();

}

void display_BL(){
  display.clearDisplay();
  display.setTextSize(1);
  display.setTextColor(WHITE);

  display.setCursor(42, 5);
  display.print("BL LINK");

  display.display();
  
}

// ------------------ MENU PHASE ------------------
void drawMenu() {
  display.clearDisplay();
  display.setTextSize(1);
  display.setTextColor(WHITE);
  display.setCursor(37, 5);
  display.print("MAIN MENU");
  for (int i = 0; i < menuItemsCount; i++) {
    display.setCursor(5, 20 + i * 15);
    display.print(menuItems[i]);

    if (i == selectedItem) {
      display.setCursor(100, 20 + i * 15);
      display.print("<--");
    }
  }

  display.display();
}

void drawConfig(){
   display.clearDisplay();
   display.setTextSize(1);
   display.setTextColor(WHITE);
    display.setCursor(44, 5);
    display.print("CONFIG");
  for (int i = 0; i < configItemsCount; i++) {
    display.setCursor(5, 20 + i * 15);
    display.print(configItems[i]);

    if (i == configItem) {
      display.setCursor(100, 20 + i * 15);
      display.print("<--");
    }
  }

  display.display();
}

// ------------------ SETUP ------------------
void setup() {
  pinMode(buttonPinSelect, INPUT_PULLUP);
  pinMode(buttonPinPush, INPUT_PULLUP);
  pinMode(buttonPinBack, INPUT_PULLUP);

  Serial2.begin(9600, SERIAL_8N1, 4, 5); // HC-12 on pins 16 (RX) and 17 (TX)

  myservo.attach(SERVO_PIN, SERVO_MIN_US, SERVO_MAX_US); 
  pinMode(LED_PIN, OUTPUT);
  digitalWrite(LED_PIN, LOW);  // LED OFF initially

  

  if (!display.begin(SSD1306_SWITCHCAPVCC, SCREEN_ADDRESS)) {
    Serial.println(F("SSD1306 allocation failed"));
    for (;;);
  }
  neogps.begin(115200, SERIAL_8N1, RXD2, TXD2);
  // Show welcome screen
  display_welcome();
  delay(2000);

  // Finally show menu
  drawMenu();
}


// ------------------ LOOP ------------------
void loop() {
  if (Serial2.available()) {
    String line = Serial2.readStringUntil('\n');   // ex: "123,456,789,12,34,999"

    lastPacketTime = millis();
    // Split values
    int v[6];
    int index = 0;
    char *token;
    char buf[64];
    line.toCharArray(buf, 64);

    token = strtok(buf, ",");
    while (token != NULL && index < 6) {
      v[index++] = atoi(token);
      token = strtok(NULL, ",");
    }

    if (index == 6) {
      value5 = v[5];  // Use the 6th value from the PIC

      // Convert ADC reading (0–1023) into angle (0–180°)
      int angle = map(value5, 0, 1023, 180, 0);

     myservo.write(angle);

      Serial.printf("value5=%d  ->  angle=%d\n", value5, angle);
    }

  }
  if (millis() - lastPacketTime < timeout) {
    digitalWrite(LED_PIN, HIGH); //Connected
  }
  else { 
    digitalWrite(LED_PIN, LOW);  //Lost connection
  }
  
  //for (unsigned long start = millis(); millis() - start < 1000;)  /// to delete
  //{
    while (neogps.available())
    {
      if (gps.encode(neogps.read()))
      {
        newData = true;
      }
    }
  //}
  
  
  int buttonStateSelect = digitalRead(buttonPinSelect);  // scroll
  int buttonStatePush   = digitalRead(buttonPinPush);    // enter
  int buttonStateBack   = digitalRead(buttonPinBack);    // back

  if (millis() - lastDebounceTime < debounceDelay) return;
  if (configMenuState == STATE_LIVE_VIEW) display_live_view();

  // ---------------- MAIN MENU ----------------
  if (configMenuState == STATE_MAIN_MENU) {
    if (buttonStateSelect == LOW) {
      lastDebounceTime = millis();
      selectedItem++;
      if (selectedItem >= menuItemsCount) selectedItem = 0;
      drawMenu();
    }

    if (buttonStatePush == LOW) {
      lastDebounceTime = millis();
      if (selectedItem == 0) {
        configMenuState = STATE_LIVE_VIEW;   // go to LIVE VIEW
        display_live_view(); // example
        
      } 
      else if (selectedItem == 1) {
        configMenuState = STATE_CONFIG_MENU; // enter CONFIG
        configItem = 0;
        drawConfig();
      } 
      else if (selectedItem == 2) {
        configMenuState = STATE_BL_LINK;   // go to BL view
        display_BL();
      }
    }

    // BACK does nothing in main menu
  }

  // ---------------- CONFIG MENU ----------------
  else if (configMenuState == STATE_CONFIG_MENU) {
    if (buttonStateSelect == LOW) {
      lastDebounceTime = millis();
      configItem++;
      if (configItem >= configItemsCount) configItem = 0;
      drawConfig();
    }

    if (buttonStatePush == LOW) {
      lastDebounceTime = millis();
      if (configItem == 0) {
        configMenuState = STATE_CONFIG_SERVO;
        display.clearDisplay();
        display.setCursor(5, 30);
        display.print("SET SERVO...");
        display.display();
      }
      else if (configItem == 1) {
        configMenuState = STATE_CONFIG_THROTTLE;
        display.clearDisplay();
        display.setCursor(5, 30);
        display.print("SET THROTTLE...");
        display.display();
      }
      else if (configItem == 2) {
        configMenuState = STATE_CONFIG_LIVEVIEW;
        display.clearDisplay();
        display.setCursor(5, 30);
        display.print("LIVEVIEW OPT...");
        display.display();
      }
    }

    if (buttonStateBack == LOW) {
      lastDebounceTime = millis();
      configMenuState = STATE_MAIN_MENU;   // back to main menu
      drawMenu();
    }
  }

  // ---------------- CONFIG SUBMENUS ----------------
  else if (configMenuState == STATE_CONFIG_SERVO) {
    if (buttonStateBack == LOW) {
      lastDebounceTime = millis();
      configMenuState = STATE_CONFIG_MENU; // back to CONFIG menu
      drawConfig();
    }
  }

  else if (configMenuState == STATE_CONFIG_THROTTLE) {
    if (buttonStateBack == LOW) {
      lastDebounceTime = millis();
      configMenuState = STATE_CONFIG_MENU;
      drawConfig();
    }
  }

  else if (configMenuState == STATE_CONFIG_LIVEVIEW) {
    if (buttonStateBack == LOW) {
      lastDebounceTime = millis();
      configMenuState = STATE_CONFIG_MENU;
      drawConfig();
    }
  }

  // ---------------- BL VIEW ----------------
  else if (configMenuState == STATE_BL_LINK) {
    if (buttonStateBack == LOW) {
      lastDebounceTime = millis();
      configMenuState = STATE_MAIN_MENU;   // back to main menu
      drawMenu();
    }
  }

  else if (configMenuState == STATE_LIVE_VIEW) {
    if (buttonStateBack == LOW) {
      lastDebounceTime = millis();
      configMenuState = STATE_MAIN_MENU; // back to CONFIG menu
      drawMenu();
    }
  }
}
